/*
 * Copyright (c) 2020 The ZMK Contributors
 *
 * SPDX-License-Identifier: MIT
 */
//123
#include "migpad.dtsi"

&kscan0 {
	col-gpios
		= <&gpio0 17 (GPIO_ACTIVE_HIGH | GPIO_PULL_DOWN)>
		, <&gpio0 20 (GPIO_ACTIVE_HIGH | GPIO_PULL_DOWN)>
		, <&gpio0 02 (GPIO_ACTIVE_HIGH | GPIO_PULL_DOWN)>
                , <&gpio0 24 (GPIO_ACTIVE_HIGH | GPIO_PULL_DOWN)>
		;
};
